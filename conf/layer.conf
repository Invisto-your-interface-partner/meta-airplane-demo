## conf/layer.conf
```bitbake
# We have a conf and classes directory, add to BBPATH
BBPATH .= ":${LAYERDIR}"

# We have recipes-* directories, add to BBFILES
BBFILES += "${LAYERDIR}/recipes-*/*/*.bb \
            ${LAYERDIR}/recipes-*/*/*.bbappend"

BBFILE_COLLECTIONS += "airplane-layer"
BBFILE_PATTERN_airplane-layer = "^${LAYERDIR}/"
BBFILE_PRIORITY_airplane-layer = "90"

LAYERDEPENDS_airplane-layer = "core"
LAYERSERIES_COMPAT_airplane-layer = "kirkstone"
```
